## edge/sdkconfig.defaults
```kconfig
# ESP32-S3 Target
CONFIG_IDF_TARGET="esp32s3"

# PSRAM Configuration
CONFIG_SPIRAM=y
CONFIG_SPIRAM_MODE_OCT=y
CONFIG_SPIRAM_SPEED_80M=y

# Camera Configuration
CONFIG_CAMERA_PIN_PWDN=GPIO_NUM_NC
CONFIG_CAMERA_PIN_RESET=GPIO_NUM_NC
CONFIG_CAMERA_PIN_XCLK=GPIO_NUM_15
CONFIG_CAMERA_PIN_SIOD=GPIO_NUM_4
CONFIG_CAMERA_PIN_SIOC=GPIO_NUM_5
CONFIG_CAMERA_PIN_D7=GPIO_NUM_16
CONFIG_CAMERA_PIN_D6=GPIO_NUM_17
CONFIG_CAMERA_PIN_D5=GPIO_NUM_18
CONFIG_CAMERA_PIN_D4=GPIO_NUM_12
CONFIG_CAMERA_PIN_D3=GPIO_NUM_10
CONFIG_CAMERA_PIN_D2=GPIO_NUM_8
CONFIG_CAMERA_PIN_D1=GPIO_NUM_14
CONFIG_CAMERA_PIN_D0=GPIO_NUM_13
CONFIG_CAMERA_PIN_VSYNC=GPIO_NUM_6
CONFIG_CAMERA_PIN_HREF=GPIO_NUM_7
CONFIG_CAMERA_PIN_PCLK=GPIO_NUM_11
CONFIG_CAMERA_XCLK_FREQ=20000000

# Performance
CONFIG_ESP_DEFAULT_CPU_FREQ_MHZ_240=y
CONFIG_FREERTOS_HZ=1000
```
